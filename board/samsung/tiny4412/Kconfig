## board/samsung/tiny4412/Kconfig
```kconfig
if TARGET_TINY4412

config SYS_BOARD
	default "tiny4412"

config SYS_VENDOR
	default "samsung"

config SYS_CONFIG_NAME
	default "tiny4412"

endif
```

## board/samsung/tq2440/Kconfig
```kconfig
if TARGET_TQ2440

config SYS_BOARD
	default "tq2440"

config SYS_VENDOR
	default "samsung"

config SYS_SOC
	default "s3c24x0"

config SYS_CONFIG_NAME
	default "tq2440"

endif
```

## configs/tiny4412_defconfig
```kconfig
CONFIG_ARM=y
CONFIG_ARCH_EXYNOS=y
CONFIG_TARGET_TINY4412=y
CONFIG_DEFAULT_DEVICE_TREE="exynos4412-tiny4412"
CONFIG_SYS_MALLOC_CLEAR_ON_INIT is not set
# CONFIG_CMD_IMLS is not set
# CONFIG_CMD_XIMG is not set
# CONFIG_CMD_FPGA is not set
# CONFIG_CMD_NFS is not set
# CONFIG_CMD_MISC is not set
# CONFIG_CMD_PMIC is not set
# CONFIG_CMD_REGULATOR is not set
CONFIG_OF_CONTROL=y
CONFIG_SPL_DISABLE_OF_CONTROL=y
CONFIG_DM_I2C=y
CONFIG_DM_I2C_COMPAT=y
CONFIG_USB=y
CONFIG_DM_USB=y
CONFIG_ERRNO_STR=y
```
